## yocto/meta-semilla/conf/distro/semilla.conf
```bitbake
DISTRO = "semilla"
DISTRO_NAME = "Semilla (Package Builder Distribution)"
DISTRO_VERSION = "0.1.0"
DISTRO_CODENAME = "hilonegro"
SDK_VENDOR = "-semillasdk"
SDK_VERSION = "${@d.getVar('DISTRO_VERSION').replace('snapshot-${METADATA_REVISION}', 'snapshot')}"
SDK_VERSION[vardepvalue] = "${SDK_VERSION}"

MAINTAINER = "Iván Chavero <ichavero@chavero.com.mx>"

TARGET_VENDOR = "-semilla"

LOCALCONF_VERSION = "2"

# Override these in semilla based distros
SEMILLA_DEFAULT_DISTRO_FEATURES = ""
SEMILLA_DEFAULT_EXTRA_RDEPENDS = "packagegroup-core-boot"
SEMILLA_DEFAULT_EXTRA_RRECOMMENDS = "packagegroup-core-boot bash"

# Don't build a kernel because we're gonna be a container image
PREFERRED_PROVIDER_virtual/kernel = "linux-dummy"

# This is a bootstrap distro so we don't need this packages
DISTRO_FEATURES:remove = " 3g x11 wayland alsa bluetooth opengl wifi systemd pam selinux ipsec zeroconf info doc man "

DISTRO_FEATURES ?= "${DISTRO_FEATURES_DEFAULT} ${SEMILLA_DEFAULT_DISTRO_FEATURES}"

PREFERRED_VERSION_linux-yocto ?= "6.15%"
PREFERRED_VERSION_linux-yocto-rt ?= "6.15%"

# Don't include package documentation to save space
INHIBIT_PACKAGE_DOC = "1"
INHIBIT_PACKAGE_LOCALE = "1"

SDK_NAME = "${DISTRO}-${TCLIBC}-${SDKMACHINE}-${IMAGE_BASENAME}-${TUNE_PKGARCH}-${MACHINE}"
SDKPATHINSTALL = "/opt/${DISTRO}/${SDK_VERSION}"

DISTRO_EXTRA_RDEPENDS += "${SEMILLA_DEFAULT_EXTRA_RDEPENDS}"
DISTRO_EXTRA_RRECOMMENDS += "${SEMILLA_DEFAULT_EXTRA_RRECOMMENDS}"

PACKAGE_CLASSES ?= "package_rpm"

SANITY_TESTED_DISTROS ?= " \
            poky-5.1 \n \
            poky-5.2 \n \
            ubuntu-22.04 \n \
            ubuntu-24.04 \n \
            ubuntu-24.10 \n \
            fedora-39 \n \
            fedora-40 \n \
            fedora-41 \n \
            fedora-42 \n \
            centosstream-9 \n \
            debian-11 \n \
            debian-12 \n \
            opensuseleap-15.5 \n \
            opensuseleap-15.6 \n \
            almalinux-8.8 \n \
            almalinux-9.2 \n \
            rocky-8 \n \
            rocky-9 \n \
            "
# add semilla sanity bbclass
INHERIT += "semilla-sanity"

# QA check settings - a little stricter than the OE-Core defaults
# (none currently necessary as we now match OE-Core)
#WARN_TO_ERROR_QA = "X"
#WARN_QA:remove = "${WARN_TO_ERROR_QA}"
#ERROR_QA:append = " ${WARN_TO_ERROR_QA}"

require conf/distro/include/semilla-world-exclude.inc
require conf/distro/include/no-static-libs.inc
require conf/distro/include/yocto-uninative.inc
require conf/distro/include/security_flags.inc
require conf/distro/include/yocto-space-optimize.inc
INHERIT += "uninative"

BB_SIGNATURE_HANDLER ?= "OEEquivHash"
BB_HASHSERVE ??= "auto"

SEMILLA_INIT_MANAGER = "sysvinit"
INIT_MANAGER ?= "${SEMILLA_INIT_MANAGER}"

# We need debug symbols so that SPDX license manifests for the kernel work
KERNEL_EXTRA_FEATURES:append = " features/debug/debug-kernel.scc"

# Enable creation of SPDX manifests by default
INHERIT += "create-spdx"
#HOSTTOOLS += "makeinfo"
```

## yocto/meta-semilla/conf/layer.conf
```bitbake
# We have a conf and classes directory, add to BBPATH
BBPATH .= ":${LAYERDIR}"

# We have recipes-* directories, add to BBFILES
BBFILES += "${LAYERDIR}/recipes-*/*/*.bb \
            ${LAYERDIR}/recipes-*/*/*.bbappend"

BBFILE_COLLECTIONS += "meta-semilla"
BBFILE_PATTERN_meta-semilla = "^${LAYERDIR}/"
BBFILE_PRIORITY_meta-semilla = "6"

LAYERDEPENDS_meta-semilla = "core"
LAYERSERIES_COMPAT_meta-semilla = "whinlatter"
PACKAGE_EXCLUDE += " mobile-broadband-provider-info "

#base_bindir = "/usr/bin/"

#PACKAGE_CLASSES = "package_rpm"

#IMAGE_INSTALL:remove = " libstd-rs python3-maturin rust-sdk-target packagegroup-base-3g packagegroup-base-phone ofono mobile-broadband-provider-info "
IMAGE_INSTALL:remove = " packagegroup-base-3g packagegroup-base-phone ofono mobile-broadband-provider-info "
PACKAGE_EXCLUDE += " opackagegroup-base-3g packagegroup-base-phone ofono mobile-broadband-provider-info"
#PACKAGE_EXCLUDE += " libstd-rs python3-maturin rust-sdk-target opackagegroup-base-3g packagegroup-base-phone ofono mobile-broadband-provider-info"
SKIP_RECIPE[mobile-broadband-provider-info] = "This package is not needed for my build."
SKIP_RECIPE[ofono] = "This package is not needed for my build."
SKIP_RECIPE[packagegroup-base-3g] = "This package is not needed for my build."
SKIP_RECIPE[packagegroup-base-phone] = "This package is not needed for my build."
#SKIP_RECIPE[python3-maturin] = "This package is not needed for my build."
#SKIP_RECIPE[packagegroup-rust-sdk-target] = "This package is not needed for my build."
#SKIP_RECIPE[rust] = "This package is not needed for my build."
#SKIP_RECIPE[libstd-rs] = "This package is not needed for my build."
```
